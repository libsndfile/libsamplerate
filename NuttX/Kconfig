## NuttX/Kconfig
```kconfig
#
# For a description of the syntax of this configuration file,
# see the file kconfig-language.txt in the NuttX tools repository.
#

config AUDIO_SRC
       bool "Audio Samplerate Convertor Library"
       default n
       ---help---
               Enable build for various SRC functions

if AUDIO_SRC

endif # LIBSRC
```
